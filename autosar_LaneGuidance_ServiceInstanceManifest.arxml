AUTOSAR XML (schema 00047)
package /LaneGuidance_Deployments
  user defined service interface deployment UserDefinedDeployment_RP1
  user defined service interface deployment UserDefinedDeployment_PP1
package /LaneGuidance_ServiceInstanceToPortMappings
  service instance to port prototype mapping Mapping_RP1: port-prototype=LaneGuidance.RequiredPort, process=DefaultInstance, service-instance=UserDefinedSI_RP1
  service instance to port prototype mapping Mapping_PP1: port-prototype=LaneGuidance.ProvidedPort, process=DefaultInstance, service-instance=UserDefinedSI_PP1
package /LaneGuidance_ServiceInstances
  required user defined service instance UserDefinedSI_RP1: service-interface=UserDefinedDeployment_RP1
  provided user defined service instance UserDefinedSI_PP1: service-interface=UserDefinedDeployment_PP1
