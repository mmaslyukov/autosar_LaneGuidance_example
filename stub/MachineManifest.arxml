AUTOSAR XML (schema 00047)
package /MachineStates
  mode declaration group DefaultMachineStates: initial-mode=Running
    6 x mode:
      Off: value=1
      Startup: value=2
      Running: value=3
      Idle: value=4
      Shutdown: value=5
      Restart: value=6
package /Machines
  machine Host: default-application-timeout={enter-timeout-value=60, exit-timeout-value=60}
    function-groups:
      mode declaration group prototype Host_ModeDeclarationGroupElement: sw-calibration-access=READ-ONLY, type=DefaultMachineStates
    os module instantiation HostOsInstantiation
      resource group DefaultResourceGroup: cpu-usage=100, mem-usage=4096000000
    per-state-timeouts:
      {state=Off, timeout={enter-timeout-value=60, exit-timeout-value=60}}
      {state=Startup, timeout={enter-timeout-value=60, exit-timeout-value=60}}
      {state=Running, timeout={enter-timeout-value=60, exit-timeout-value=60}}
      {state=Idle, timeout={enter-timeout-value=60, exit-timeout-value=5}}
      {state=Shutdown, timeout={enter-timeout-value=60, exit-timeout-value=60}}
      {state=Restart, timeout={enter-timeout-value=120, exit-timeout-value=60}}
