AUTOSAR XML (schema 00047)
package /LaneGuidance_Executable
  executable autosar_LaneGuidance: build-type=BUILD-TYPE-DEBUG
    root sw component prototype autosar_LaneGuidance_RootSwComponentPrototype: application-type=LaneGuidance
package /LaneGuidance_ProcessToMachineMappingSet
  process to machine mapping set ProcessToMachineMappingSet
    process to machine mapping DefaultMapping: machine=Host, process=DefaultInstance
package /LaneGuidance_Processes
  process DefaultInstance: executable=autosar_LaneGuidance, log-trace-default-log-level=WARN, log-trace-log-mode=CONSOLE, log-trace-process-desc=Log messages for adaptive application autosar_LaneGuidance, log-trace-process-id=8147, state-dependent-startup-config{function-group-state=Host_ModeDeclarationGroupElement.Running, resource-group=DefaultResourceGroup, startup-config=StartupConfigRR}
package /LaneGuidance_StartupConfigSets
  startup config set DefaultStartupConfigSet
    startup config StartupConfigRR: scheduling-policy=SCHEDULING-POLICY-ROUND-ROBIN, scheduling-priority=32
    startup config StartupConfigFifo: scheduling-policy=SCHEDULING-POLICY-FIFO, scheduling-priority=32
    startup config StartupConfigOther: scheduling-policy=SCHEDULING-POLICY-OTHER, scheduling-priority=32
